## boards/shields/PNCATEHO/Kconfig.defconfig
```kconfig
# Copyright (c) 2020 The ZMK Contributors
# SPDX-License-Identifier: MIT

if SHIELD_PNCATEHO

config ZMK_KEYBOARD_NAME
    default "PNCATEHO"

config ZMK_SPLIT
	default n

config USB_DEVICE_PRODUCT
	default "PNCATENO"

config USB_DEVICE_VID
	default "0x0000"

config USB_DEVICE_PID
	default "0xFEED"

config USB_DEVICE_MANUFACTURER
	default "aroum"

endif
```

## config/boards/shields/PNCATEHO/Kconfig.defconfig
```kconfig
if SHIELD_PNCATEHO_LEFT

config ZMK_KEYBOARD_NAME
    default "PNCATEHO"

config ZMK_SPLIT
    default n
endif
```
