## config/boards/shields/risateno/Kconfig.defconfig
```kconfig
# Copyright (c) 2020 The ZMK Contributors
# SPDX-License-Identifier: MIT

if SHIELD_PNCATEHO

config ZMK_KEYBOARD_NAME
    default "PNCATEHO"

endif
```

## config/boards/shields/risateno/Kconfig.shield
```kconfig
 #
 # Copyright (c) 2020 The ZMK Contributors
 #
 # SPDX-License-Identifier: MIT
 #

config SHIELD_PNCATEHO
    def_bool $(shields_list_contains,PNCATEHO)
```
